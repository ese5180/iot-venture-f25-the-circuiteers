

&arduino_spi {
 status = "okay";
 cs-gpios = <&gpio1 6 GPIO_ACTIVE_LOW>; 

 lora0: sx1276@0 {
  compatible = "semtech,sx1276";
  reg = <0>;
  spi-max-frequency = <1000000>;
  label = "SX1276_LORA";
  
  reset-gpios = <&gpio1 4 GPIO_ACTIVE_LOW>;
  dio-gpios = <&gpio1 5 (GPIO_ACTIVE_HIGH | GPIO_PULL_DOWN)>;
  
  power-amplifier-output = "pa-boost";
 };
};

/ {
 aliases {
  lora0 = &lora0;
 };
};