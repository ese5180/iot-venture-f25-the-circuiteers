## bme280/tests/BME_UNIT_TEST/testcase.yaml
```yaml
tests:
 bme280.test:
   platform_allow: qemu_cortex_m3
   tags: bme280 unit
   harness: ztest
```

## test_image/sample.yaml
```yaml
sample:
  name: Test Image Blinky with MCUboot
  description: Simple LED blinky application with MCUboot signing and DFU support
common:
  tags: gpio led mcuboot dfu
  depends_on: gpio
  harness: console
  harness_config:
    type: one_line
    regex:
      - "LED toggled"
tests:
  sample.basic.blinky:
    platform_allow: nucleo_wl55jc
```

## west.yml
```yaml
manifest:
  remotes:
    - name: zephyrproject-rtos
      url-base: https://github.com/zephyrproject-rtos

  projects:
    - name: zephyr
      remote: zephyrproject-rtos
      revision: v4.3.0-rc1
      import: true  # Import all modules to ensure all dependencies are available

  self:
    path: iot-venture-f25-the-circuiteers
```
